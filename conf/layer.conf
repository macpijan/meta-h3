## conf/layer.conf
```bitbake
# We have a conf and classes directory, add to BBPATH
BBPATH .= ":${LAYERDIR}"

# We have a recipes-* directories, add to BBFILES
BBFILES += "${LAYERDIR}/recipes-*/*/*.bb \
	${LAYERDIR}/recipes-*/*/*.bbappend"

BBFILE_COLLECTIONS += "h3"
BBFILE_PATTERN_h3 = "^${LAYERDIR}/"
BBFILE_PRIORITY_h3 = "6"
```

## conf/machine/bananapi-m2-plus.conf
```bitbake
#@TYPE: Machine
#@NAME: Bananapi m2 plus
#@DESCRIPTION: Machine configuration for
#the Bananapi m2 plus, based on allwinner H3 CPU http://orangepi.org/

require conf/machine/include/sun8i.inc

DEFAULTTUNE = "cortexa7hf-neon-vfpv4"

UBOOT_MACHINE = "Sinovoip_BPI_M2_plus_defconfig"

PREFERRED_PROVIDER_virtual/kernel = "linux-yocto-custom"

KERNEL_DEVICETREE = "sun8i-h3-bananapi-m2-plus.dtb"
KERNEL_EXTRA_ARGS += "LOADADDR=${UBOOT_ENTRYPOINT}"

PREFERRED_VERSION_u-boot = "v2017.01"
PREFERRED_VERSION_u-boot-fw-utils = "v2017.01"

IMAGE_INSTALL_append = " swupdate"

### MODULES ###

# add modules to rootfs
MACHINE_ESSENTIAL_EXTRA_RRECOMMENDS_append = " kernel-modules"
# autoload following modules on boot
KERNEL_MODULE_AUTOLOAD_append = " "

DISTRO_FEATURES_append = " x11"
DISTRO_FEATURES_remove = " wayland"

# detection is broken in recipe
PACKAGECONFIG_pn-glmark2 = "x11-gles2 drm-gles2"

IMAGE_FEATURES_append = " ssh-server-openssh"
IMAGE_INSTALL_append = " connman"
```

## conf/machine/orangepi-plus.conf
```bitbake
#@TYPE: Machine
#@NAME: OrangePi-Plus
#@DESCRIPTION: Machine configuration for the OrangePi-Plus, based on allwinner H3 CPU http://orangepi.org/

require conf/machine/include/sun8i.inc

DEFAULTTUNE = "cortexa7hf-neon-vfpv4"

UBOOT_MACHINE = "orangepi_plus_defconfig"
SUNXI_FEX_FILE = "sys_config/h3/orange_pi_plus.fex"

PREFERRED_PROVIDER_virtual/kernel = "linux-sunxi-h3"
KBUILD_DEFCONFIG_pn-linux-sunxi-h3 = "sun8iw7p1smp_defconfig"

# FIXME: this would be for mainline kernels only, but even then the
# .dts are shipped by u-boot
#KERNEL_DEVICETREE = "sun8i-h3-orangepi-plus.dtb"

## patches still missing from official trees

SRC_URI_pn-linux-sunxi-h3 = "git://github.com/O-Computers/linux-sunxi.git;branch=h3-wip;protocol=http;nocheckout=1;name=machine"
SRCREV_machine_pn-linux-sunxi-h3 = "07ab28e466560a0a08351408085ab0e3cc3873e8"

SRC_URI_pn-sunxi-board-fex = "git://github.com/vonfritz/sunxi-boards.git;branch=H3;protocol=git"
SRCREV_pn-sunxi-board-fex = "52a70990101edd807eb48afd2d1c12669a838c87"
PV_pn-sunxi-board-fex = "1.1h3+git${SRCPV}"

# detection is broken in recipe
PACKAGECONFIG_pn-glmark2 = "x11-gles2 drm-gles2"
```
